## boards/shields/allium36/Kconfig.shield
```kconfig
config SHIELD_ALLIUM36_LEFT
    def_bool $(shields_list_contains,allium36_left)

config SHIELD_ALLIUM36_RIGHT
    def_bool $(shields_list_contains,allium36_right)
```

## boards/shields/allium46/Kconfig.defconfig
```kconfig
if SHIELD_ALLIUM46_LEFT

config ZMK_KEYBOARD_NAME
    default "Allium46"

config ZMK_SPLIT_ROLE_CENTRAL
    default y

endif

if SHIELD_ALLIUM46_LEFT || SHIELD_ALLIUM46_RIGHT

config ZMK_SPLIT
    default y

endif
```

## boards/shields/allium46/Kconfig.shield
```kconfig
config SHIELD_ALLIUM46_LEFT
    def_bool $(shields_list_contains,allium46_left)

config SHIELD_ALLIUM46_RIGHT
    def_bool $(shields_list_contains,allium46_right)
```
